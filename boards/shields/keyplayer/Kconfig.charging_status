## boards/shields/keyplayer/Kconfig.charging_status
```kconfig
# Charging Status Driver Configuration

menuconfig CHARGING_STATUS
    bool "TP4056 Charging Status Driver"
    default y
    help
      Enable driver for TP4056 charging status detection.

if CHARGING_STATUS

config CHARGING_STATUS_TRIGGER
    bool "Enable trigger support"
    default y
    help
      Enable trigger support for charging status changes.

config CHARGING_STATUS_INIT_PRIORITY
    int "Init priority"
    default 80
    range 0 99
    help
      Device driver initialization priority.

module = CHARGING_STATUS
module-str = charging_status
source "subsys/logging/Kconfig.template.log_config"

endif # CHARGING_STATUS
```

## boards/shields/keyplayer/Kconfig.defconfig
```kconfig
if SHIELD_KEYPLAYER

config ZMK_KEYBOARD_NAME
    default "keyplayer"
      
endif

if ZMK_BACKLIGHT

config PWM
    default y

config LED_PWM
    default y

endif # ZMK_BACKLIGHT

# Charging Status Driver Configuration

config CHARGING_STATUS
    bool "Enable TP4056 Charging Status Driver"
    default y
    help
      Enable driver for TP4056 charging status detection on P1.09.

if CHARGING_STATUS

config CHARGING_STATUS_LOG_LEVEL
    int "Log level"
    default 3
    range 0 4
    help
      Log level for charging status driver.
      0=OFF, 1=ERROR, 2=WARN, 3=INFO, 4=DEBUG

config CHARGING_STATUS_USE_INTERRUPT
    bool "Use GPIO interrupt for state detection"
    default y
    help
      Use GPIO interrupt to detect state changes. If disabled, polling mode will be used.

endif
```

## boards/shields/keyplayer/drivers/charging_status/Kconfig.charging_status
```kconfig
# Charging Status Driver Configuration

config CHARGING_STATUS
    bool "Enable TP4056 Charging Status Driver"
    default y
    help
      Enable driver for TP4056 charging status detection on P1.09.

if CHARGING_STATUS

config CHARGING_STATUS_LOG_LEVEL
    int "Log level"
    default 3
    range 0 4
    help
      Log level for charging status driver.
      0=OFF, 1=ERROR, 2=WARN, 3=INFO, 4=DEBUG

config CHARGING_STATUS_USE_INTERRUPT
    bool "Use GPIO interrupt for state detection"
    default y
    help
      Use GPIO interrupt to detect state changes. If disabled, polling mode will be used.

endif
```

## boards/shields/keyplayer/drivers/layer_state/Kconfig.layer_state
```kconfig
menuconfig ZMK_LAYER_STATE_MANAGER
    bool "Layer State Manager"
    default y
    help
      Enable layer state manager for monitoring layer changes.


config ZMK_BEHAVIOR_LAYER_LED_INDICATOR
    bool "Enable layer LED indicator behavior"
    default y
    help
      Blinks an LED when switching to a specific layer
```

## boards/shields/keyplayer/dts/bindings/charging-monitor.yaml
```yaml
description: ZMK Charging Status Monitor

compatible: "zmk,charging-monitor"

include: base.yaml

properties:
  chrg-gpios:
    type: phandle-array
    required: true
    description: GPIO pin connected to TP4056 CHRG pin
    
  led-gpios:
    type: phandle-array
    required: true
    description: GPIO pin for charging indicator LED
    
  poll-interval-ms:
    type: int
    required: false
    default: 1000
    description: Polling interval in milliseconds
```

## boards/shields/keyplayer/dts/bindings/charging_led.yaml
```yaml
#
# Copyright (c) 2024 The ZMK Contributors
#
# SPDX-License-Identifier: MIT
#

description: Charging Status LED Indicator

compatible: "zmk,charging-led"

properties:
  led-gpios:
    type: phandle-array
    required: true
    description: >
      GPIO pin for charging indicator LED.
      Typically use GPIO_ACTIVE_HIGH for LED anode connected to GPIO,
      GPIO_ACTIVE_LOW for LED cathode connected to GPIO.

  active-low:
    type: boolean
    description: >
      If true, the LED is on when the GPIO output is low.
      This should match the GPIO flags in led-gpios.
      If not specified, defaults to false.

  label:
    type: string
    description: Human-readable string describing the device.
```

## boards/shields/keyplayer/dts/bindings/charging_monitor.yaml
```yaml
#
# Copyright (c) 2024 The ZMK Contributors
#
# SPDX-License-Identifier: MIT
#

description: TP4056 Charging Status Monitor

compatible: "zmk,charging-monitor"

properties:
  chrg-gpios:
    type: phandle-array
    required: true
    description: >
      GPIO pin connected to TP4056 CHRG pin. Should be configured with
      GPIO_ACTIVE_LOW flag for typical TP4056 behavior.

  debounce-ms:
    type: int
    default: 50
    description: Debounce time in milliseconds for state changes.

  label:
    type: string
    description: Human-readable string describing the device.
```

## boards/shields/keyplayer/dts/bindings/charging_status.yaml
```yaml
# SPDX-License-Identifier: Apache-2.0

description: TP4056 Charging Status Detector
compatible: "charging-status"

include:
  - base.yaml
  - gpio.yaml

properties:
  status-gpios:
    required: true
    type: phandle-array
    description: GPIO pin for CHRG signal (active low)

  label:
    type: string
    description: Human readable string describing the device
```

## boards/shields/keyplayer/dts/bindings/zmk,tp4056-charger.yaml
```yaml
# Copyright (c) 2024 The ZMK Contributors
# SPDX-License-Identifier: MIT

description: ZMK TP4056 Charger Status Sensor

compatible: "zmk,tp4056-charger"

include: [base.yaml, gpio.yaml]

properties:
  chrg-gpios:
    type: phandle-array
    required: true
    description: GPIO pin for TP4056 CHRG signal (active low)

  led-gpios:
    type: phandle-array
    required: true
    description: GPIO pin for LED indicator

  debounce-ms:
    type: int
    required: false
    description: Debounce time in milliseconds
    default: 50

child-binding:
  description: TP4056 charger sensor
```
