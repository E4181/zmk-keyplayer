## boards/shields/keyplayer/driver/gpio/Kconfig.mcp23017
```kconfig
# Copyright (c) 2024 Your Name
# SPDX-License-Identifier: MIT

config GPIO_MCP23017
    bool "MCP23017 I2C GPIO expander"
    default y
    depends on I2C
    help
      Enable driver for Microchip MCP23017 I2C-based GPIO expansion chip.
```

## boards/shields/keyplayer/dts/bindings/charge-monitor.yaml
```yaml
description: TP4056 charge monitor
compatible: "zmk,charge-monitor"
include: base.yaml
properties:
  chrg-gpios:
    type: phandle-array
    required: true
    description: GPIO for TP4056 CHRG pin
```

## boards/shields/keyplayer/dts/bindings/pixart,tp4056-charger.yaml
```yaml
description: |
  Driver for monitoring TP4056 lithium battery charger status via CHRG pin

compatible: "pixart,tp4056-charger"

include: base.yaml

properties:
  chrg-gpios:
    type: phandle-array
    required: true
    description: GPIO pin connected to TP4056 CHRG pin (active low)
    
  poll-interval-ms:
    type: int
    required: false
    default: 1000
    description: Polling interval in milliseconds (used in polling mode)
    
  debounce-ms:
    type: int
    required: false
    default: 50
    description: Debounce time for state changes
    
  label:
    type: string
    required: false
    description: Human readable name for the device

required:
  - chrg-gpios

additionalProperties: false

examples:
  - |
    tp4056_charger {
        compatible = "pixart,tp4056-charger";
        chrg-gpios = <&gpio0 9 GPIO_ACTIVE_LOW>;
        label = "TP4056_CHARGER";
        poll-interval-ms = <1000>;
        debounce-ms = <50>;
    };
```

## boards/shields/keyplayer/dts/bindings/zmk,behavior-layer-led-indicator.yaml
```yaml
# Copyright (c) 2024
# SPDX-License-Identifier: MIT

description: Layer LED indicator behavior

compatible: "zmk,behavior-layer-led-indicator"

include: zero_param.yaml

properties:
  led-gpios:
    type: phandle-array
    required: true
    description: GPIO pin for LED control
    
  target-layer:
    type: int
    required: true
    description: Layer number that triggers LED blinking
    
  blink-count:
    type: int
    required: false
    default: 5
    description: Number of times to blink
    
  blink-period-ms:
    type: int
    required: false
    default: 1000
    description: Period of one blink cycle (on+off) in milliseconds
    
  on-duration-ms:
    type: int
    required: false
    default: 100
    description: LED on duration in milliseconds
```

## boards/shields/keyplayer/dts/bindings/zmk,charger-monitor.yaml
```yaml
# Copyright (c) 2024
# SPDX-License-Identifier: MIT

description: ZMK TP4056 Charger Monitor

compatible: "zmk,charger-monitor"

include: [gpio-device.yaml]

properties:
  compatible:
    type: string-array
    required: true
    description: Should be "zmk,charger-monitor"

  label:
    type: string
    required: false
    description: Human readable string describing the device

  chrg-gpios:
    type: phandle-array
    required: true
    description: |
      GPIO pin connected to TP4056 CHRG pin.
      The pin should be configured with GPIO_INPUT flag.
      Since CHRG is active-low, use GPIO_ACTIVE_LOW flag.

  status:
    type: string
    required: false
    description: Device status

  zephyr,debounce-ms:
    type: int
    required: false
    description: Debounce time in milliseconds
    default: 50

required:
  - compatible
  - chrg-gpios
```

## boards/shields/keyplayer/dts/bindings/zmk,charger-tp4056.yaml
```yaml
# Copyright (c) 2024 The ZMK Contributors
# SPDX-License-Identifier: MIT

description: |
  TP4056 charger detection via CHRG pin with LED indicator

compatible: "zmk,charger-tp4056"

properties:
  chrg-gpios:
    type: phandle-array
    required: true
    description: GPIO pin connected to TP4056 CHRG pin (active low)
  led-gpios:
    type: phandle-array
    required: true
    description: GPIO pin for charging status LED indicator
  debounce-ms:
    type: int
    required: false
    description: Debounce time in milliseconds for charger status changes
    default: 50
  status:
    type: string
    required: false
```

## boards/shields/keyplayer/dts/bindings/zmk,charging-monitor.yaml
```yaml
# SPDX-License-Identifier: MIT

description: |
  Charging monitor for ZMK keyboards using TP4056 CHRG pin.

compatible: "zmk,charging-monitor"

include: [base.yaml]

properties:
  chrg-gpios:
    type: phandle-array
    required: true
    description: GPIO pin for TP4056 CHRG status detection.

  chrg-active-low:
    type: boolean
    description: Whether the CHRG pin is active low (true for TP4056).
    # 注意：布尔类型不要设置 default
    # 在设备树中通过存在/不存在来表示 true/false
```
